## conf/machine/friendlyelec-nanopik2.conf
```bitbake
#@TYPE: Machine
#@NAME: FriendlyElec's NanoPi K2 machine
#@DESCRIPTION: Machine configuration

require conf/machine/include/amlogic-s905.inc
require conf/machine/include/friendlyelec-nanopik2-dtb.inc
require conf/machine/include/amlogic-modern-boot.inc

MACHINE_FEATURES_append = " alsa ext2 screen usbgadget usbhost sdio vfat"

PREFERRED_PROVIDER_amlogic-fip ?= "amlogic-fip-prebuilt"
PREFERRED_PROVIDER_virtual/bootloader ?= "u-boot-meson-gx"
PREFERRED_PROVIDER_u-boot ?= "u-boot-meson-gx"
PREFERRED_VERSION_u-boot-meson-gx ?= "2020.10%"

UBOOT_MACHINE = "nanopi-k2_defconfig"
```

## conf/machine/hardkernel-odroidc2.conf
```bitbake
#@TYPE: Machine
#@NAME: Odroid-C2 machine
#@DESCRIPTION: Machine configuration

require conf/machine/include/amlogic-s905.inc
require conf/machine/include/hardkernel-odroidc2-dtb.inc
require conf/machine/include/amlogic-modern-boot.inc

MACHINE_FEATURES_append = " alsa ext2 screen usbgadget usbhost vfat"

PREFERRED_PROVIDER_amlogic-fip ?= "amlogic-fip-odroidc2"
PREFERRED_PROVIDER_virtual/bootloader ?= "u-boot-meson-gx"
PREFERRED_PROVIDER_u-boot ?= "u-boot-meson-gx"
PREFERRED_VERSION_u-boot-meson-gx ?= "2020.10%"

UBOOT_MACHINE = "odroid-c2_config"
```
